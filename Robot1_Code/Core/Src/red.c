/* =============================================================================
 *  red.c — Улаан (red) талын автомат код
 *
 *  sequence.c доторх бүтэн блокуудыг гинжлэн улаан талын дарааллыг угсарна.
 *  Red_Run()-г main loop-д давтан дуудна; бүх дараалал дуусахад 1 буцаана.
 *
 *  Төсөл : STM32F407 Robot Firmware
 *  Огноо : Jul 1, 2026
 *  Автор : nova
 * =============================================================================
 */
#include "red.h"

/* ---- Улаан талын дарааллын төлөвүүд (блокуудын дараалал) ----------------- */
enum {
    RED_UP_20 = 0,   // up_20_function ажиллана
    RED_DOWN_20,     // down_20_function
    RED_UP_40,       // up_40_function
    RED_DOWN_40,     // down_40_function
    RED_DONE         // дууссан
};

static int red_state = RED_UP_20;

/* -----------------------------------------------------------------------------
 *  Red_Run — Улаан талын дарааллыг нэг алхмаар ажиллуулах (NON-BLOCKING)
 *    Блок бүр 1 буцаамагц дараагийн блок руу шилжинэ.
 *    return: 1 = бүх дараалал дууссан, 0 = үргэлжилж байна
 *
 *  ТЭМДЭГЛЭЛ: блокуудын дараалал/сонголтыг энд чөлөөтэй өөрчилж болно
 *  (жишээ нь зарим блокийг алгасах, эсвэл дарааллыг солих).
 * -----------------------------------------------------------------------------
 */
uint8_t Red_Run(void) {

    switch (red_state) {

    case RED_UP_20:
        if (up_20_function())   red_state = RED_DOWN_20;
        break;

    case RED_DOWN_20:
        if (down_20_function()) red_state = RED_UP_40;
        break;

    case RED_UP_40:
        if (up_40_function())   red_state = RED_DOWN_40;
        break;

    case RED_DOWN_40:
        if (down_40_function()) red_state = RED_DONE;
        break;

    case RED_DONE:
        brake();
        return 1;
    }

    return 0;
}

/* -----------------------------------------------------------------------------
 *  Red_Reset — Улаан талын дарааллыг эхнээс нь дахин эхлүүлэх
 *  (бүх блокийн дотоод төлвийг цэвэрлэнэ)
 * -----------------------------------------------------------------------------
 */
void Red_Reset(void) {
    red_state = RED_UP_20;
    up_20_reset();
    down_20_reset();
    up_40_reset();
    down_40_reset();
}
